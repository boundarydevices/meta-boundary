## conf/distro/ezurio-b2qt.conf
```bitbake
include conf/distro/include/fsl-imx-base.inc
require conf/distro/b2qt.conf

DISTRO = "ezurio-b2qt"
DISTRO_NAME = "Ezurio b2qt"
DISTRO_FEATURES:append = " wayland "

# Need to override setting in meta-boot2qt layer (fsl.inc) to use boundary u-boot and kernel
IMX_DEFAULT_BOOTLOADER:imx-nxp-bsp = "u-boot-boundary"
PREFERRED_PROVIDER_virtual/kernel:imx-nxp-bsp = "linux-boundary"

PREFERRED_PROVIDER_networkmanager = "summit-networkmanager"
PREFERRED_RPROVIDER_networkmanager = "summit-networkmanager"
PREFERRED_RPROVIDER_networkmanager-nmcli = "summit-networkmanager"
PREFERRED_RPROVIDER_wireless-regdb-static = "wireless-regdb"
PREFERRED_PROVIDER_wpa-supplicant = "summit-supplicant"
PREFERRED_RPROVIDER_wpa-supplicant = "summit-supplicant"
PREFERRED_RPROVIDER_wpa-supplicant-cli = "summit-supplicant"
PREFERRED_RPROVIDER_wpa-supplicant-passphrase = "summit-supplicant"
PREFERRED_RPROVIDER_wpa-supplicant-lib = "summit-supplicant"

IMAGE_FSTYPES += " wic.gz"

MACHINE_USES_VIVANTE_KERNEL_DRIVER_MODULE = "1"

QT_QPA_PLATFORM = "wayland-egl"
```

## conf/distro/fsl-imx-xwayland-boundary.conf
```bitbake
# i.MX DISTRO for Wayland with X11

include conf/distro/include/fsl-imx-base.inc
include conf/distro/include/fsl-imx-preferred-env.inc

DISTRO = "fsl-imx-xwayland-boundary"

# Remove conflicting backends
DISTRO_FEATURES:remove = "directfb "
DISTRO_FEATURES:append = " x11 wayland pam"

PREFERRED_PROVIDER_virtual/kernel:imx-nxp-bsp = "linux-boundary"
PREFERRED_PROVIDER_virtual/bootloader:imx-nxp-bsp = "u-boot-boundary"

PREFERRED_RPROVIDER_networkmanager = "summit-networkmanager"
PREFERRED_RPROVIDER_networkmanager-nmcli = "summit-networkmanager"
PREFERRED_RPROVIDER_wireless-regdb-static = "wireless-regdb"
PREFERRED_RPROVIDER_wpa-supplicant = "summit-supplicant"
PREFERRED_RPROVIDER_wpa-supplicant-cli = "summit-supplicant"
PREFERRED_RPROVIDER_wpa-supplicant-passphrase = "summit-supplicant"

IMAGE_FSTYPES += " wic.gz wic.sparse"
IMAGE_CLASSES += " image_types_sparse"


MACHINE_USES_VIVANTE_KERNEL_DRIVER_MODULE = "1"

# Route the 3D graphics routing engine back to NXP's Vivante stack for i.MX8MQ
PREFERRED_PROVIDER_virtual/egl:mx8mq-nxp-bsp = "imx-gpu-viv"
PREFERRED_PROVIDER_virtual/libgles1:mx8mq-nxp-bsp = "imx-gpu-viv"
PREFERRED_PROVIDER_virtual/libgles2:mx8mq-nxp-bsp = "imx-gpu-viv"
PREFERRED_PROVIDER_virtual/libgles3:mx8mq-nxp-bsp = "imx-gpu-viv"
PREFERRED_PROVIDER_virtual/libgbm:mx8mq-nxp-bsp = "imx-gpu-viv"
PREFERRED_PROVIDER_virtual/mesa:mx8mq-nxp-bsp = "mesa-gl"
CORE_IMAGE_EXTRA_INSTALL:append:mx8mq-nxp-bsp = " imx-gpu-viv imx-gpu-viv-tools"
```

## conf/distro/include/b2qt.inc
```bitbake
include conf/distro/include/imx.inc

DEPLOY_CONF_NAME:nitrogen8m = "Ezurio Nitrogen8M"
DEPLOY_CONF_NAME:nitrogen8mm = "Ezurio Nitrogen8M Mini"
DEPLOY_CONF_NAME:nitrogen8mp = "Ezurio Nitrogen8M Plus"
DEPLOY_CONF_NAME:nitrogen8ulp = "Ezurio Nitrogen8ULP"
DEPLOY_CONF_NAME:nitrogen93 = "Ezurio Nitrogen93"
DEPLOY_CONF_NAME:nitrogen95 = "Ezurio Nitrogen95"
DEPLOY_CONF_TYPE = "Boot2Qt 6.8.1"

DRI_DEVICE:nitrogen8m = "card0"
DRI_DEVICE:nitrogen8mm = "card0"
DRI_DEVICE:nitrogen8mp = "card1"

IMAGE_BUILDINFO_VARS:append = " DEPLOY_CONF_NAME DEPLOY_CONF_TYPE"
```

## conf/machine/nitrogen91.conf
```bitbake
#@TYPE: Machine
#@NAME: Ezurio Nitrogen 91 based platforms
#@SOC: i.MX91
#@DESCRIPTION: Machine configuration for Ezurio Nitrogen91 SMARC
#@MAINTAINER: Gary Bisson <gary.bisson@ezurio.com>

MACHINEOVERRIDES =. "mx91:"

IMX_DEFAULT_BSP ?= "nxp"

require conf/machine/include/imx-base.inc
require conf/machine/include/arm/armv8-2a/tune-cortexa55.inc

# Kernel configuration
PREFERRED_PROVIDER_virtual/kernel ??= "linux-boundary"
KERNEL_DEVICETREE = " \
    freescale/imx91-nitrogen-smarc.dtb \
    freescale/imx91-nitrogen-smarc-nx611.dtb \
    freescale/imx91-nitrogen-smarc-ti351.dtb \
"
KERNEL_IMAGETYPE = "Image"
RRECOMMENDS:${KERNEL_PACKAGE_NAME}-base = ""

# U-Boot configuration
IMX_DEFAULT_BOOTLOADER:imx-nxp-bsp = "u-boot-boundary"
PREFERRED_PROVIDER_u-boot ??= "u-boot-boundary"
PREFERRED_PROVIDER_virtual/bootloader ??= "u-boot-boundary"
LOADADDR = ""
SPL_BINARY = "spl/u-boot-spl.bin"
UBOOT_DTB_NAME = "imx91-nitrogen-smarc.dtb"
UBOOT_MAKE_TARGET = ""
UBOOT_SUFFIX = "bin"
UBOOT_CONFIG ??= "sd"
UBOOT_CONFIG[sd]     = "imx91_nitrogen_smarc_defconfig,sdcard"

ATF_PLATFORM = "imx91"

DDR_FIRMWARE_NAME = " \
    lpddr4_dmem_1d_v202201.bin \
    lpddr4_dmem_2d_v202201.bin \
    lpddr4_imem_1d_v202201.bin \
    lpddr4_imem_2d_v202201.bin \
"

IMXBOOT_TARGETS = "flash_singleboot"
IMX_BOOT_SOC_TARGET = "iMX91"
IMX_BOOT_SEEK = "32"

IMAGE_BOOT_FILES:append = " \
	boot.scr-${MACHINE};boot.scr \
	upgrade.scr-${MACHINE};upgrade.scr \
	imx-boot-nitrogen91-sd.bin-flash_singleboot;u-boot.imx91_nitrogen_smarc \
"

# wic support
WKS_FILE = "sdimage-bootpart.wks"
WKS_FILE_DEPENDS += "u-boot-script-boundary"

SERIAL_CONSOLES = "115200;ttyLP0"
```

## conf/machine/nitrogen93.conf
```bitbake
#@TYPE: Machine
#@NAME: Ezurio Nitrogen 93 based platforms
#@SOC: i.MX93
#@DESCRIPTION: Machine configuration for Ezurio Nitrogen93 SMARC
#@MAINTAINER: Gary Bisson <gary.bisson@ezurio.com>

MACHINEOVERRIDES =. "mx93:"

IMX_DEFAULT_BSP ?= "nxp"

require conf/machine/include/imx-base.inc
require conf/machine/include/arm/armv8-2a/tune-cortexa55.inc

MACHINE_FIRMWARE:append = " ethos-u-firmware"

# Kernel configuration
PREFERRED_PROVIDER_virtual/kernel ??= "linux-boundary"
KERNEL_DEVICETREE = "freescale/imx93-nitrogen-smarc.dtb \
	freescale/imx93-nitrogen-smarc-ethosu.dtb \
	freescale/imx93-nitrogen-smarc-lvds.dtb \
	freescale/imx93-nitrogen-smarc-lvds-nx611.dtb \
	freescale/imx93-nitrogen-smarc-lvds-tevs.dtb \
	freescale/imx93-nitrogen-smarc-nx611.dtb \
	freescale/imx93-nitrogen-smarc-ov5640.dtb \
	freescale/imx93-nitrogen-smarc-rpmsg.dtb \
	freescale/imx93-nitrogen-smarc-spi-slave.dtb \
	freescale/imx93-nitrogen-smarc-tevs.dtb \
	freescale/imx93-nitrogen-smarc-ti351.dtb \
	freescale/imx93-nvc.dtb \
	freescale/imx93-nvc-rpmsg.dtb \
"
KERNEL_IMAGETYPE = "Image"
RRECOMMENDS:${KERNEL_PACKAGE_NAME}-base = ""

# U-Boot configuration
IMX_DEFAULT_BOOTLOADER:imx-nxp-bsp = "u-boot-boundary"
PREFERRED_PROVIDER_u-boot ??= "u-boot-boundary"
PREFERRED_PROVIDER_virtual/bootloader ??= "u-boot-boundary"
LOADADDR = ""
SPL_BINARY = "spl/u-boot-spl.bin"
UBOOT_DTB_NAME = "imx93-nitrogen-smarc.dtb"
UBOOT_MAKE_TARGET = ""
UBOOT_SUFFIX = "bin"
UBOOT_CONFIG ??= "sd"
UBOOT_CONFIG[sd]     = "imx93_nitrogen_smarc_defconfig,sdcard"

ATF_PLATFORM = "imx93"

DDR_FIRMWARE_NAME = " \
    lpddr4_dmem_1d_v202201.bin \
    lpddr4_dmem_2d_v202201.bin \
    lpddr4_imem_1d_v202201.bin \
    lpddr4_imem_2d_v202201.bin \
"

IMXBOOT_TARGETS = "flash_singleboot"
IMX_BOOT_SOC_TARGET = "iMX9"
IMX_BOOT_SEEK = "32"

IMAGE_BOOT_FILES:append = " \
	boot.scr-${MACHINE};boot.scr \
	upgrade.scr-${MACHINE};upgrade.scr \
	imx-boot-nitrogen93-sd.bin-flash_singleboot;u-boot.imx93_nitrogen_smarc \
"

# wic support
WKS_FILE = "sdimage-bootpart.wks"
WKS_FILE_DEPENDS += "u-boot-script-boundary"

SERIAL_CONSOLES = "115200;ttyLP0"
```

## conf/machine/nitrogen95.conf
```bitbake
#@TYPE: Machine
#@NAME: Ezurio Nitrogen 95 based platforms
#@SOC: i.MX95
#@DESCRIPTION: Machine configuration for Ezurio Nitrogen95 SMARC
#@MAINTAINER: Gary Bisson <gary.bisson@ezurio.com>

MACHINEOVERRIDES =. "mx95:"

IMX_DEFAULT_BSP ?= "nxp"

require conf/machine/include/imx-base.inc
require conf/machine/include/arm/armv8-2a/tune-cortexa55.inc

MACHINE_FEATURES += "pci wifi bluetooth"
MACHINE_FEATURES:append:use-nxp-bsp = " jailhouse dpdk xen"

# Kernel configuration
PREFERRED_PROVIDER_virtual/kernel ??= "linux-boundary"
KERNEL_DEVICETREE = "freescale/imx95-nitrogen-smarc.dtb \
	freescale/imx95-nitrogen-smarc-csi0-pivariety.dtbo \
	freescale/imx95-nitrogen-smarc-csi1-pivariety.dtbo \
	freescale/imx95-nitrogen-smarc-csi0-tevs.dtbo \
	freescale/imx95-nitrogen-smarc-csi1-tevs.dtbo \
	freescale/imx95-nitrogen-smarc-dsi.dtbo \
	freescale/imx95-nitrogen-smarc-lvds0.dtbo \
	freescale/imx95-nitrogen-smarc-lvds1.dtbo \
	freescale/imx95-nitrogen-smarc-nx611.dtbo \
"
KERNEL_IMAGETYPE = "Image"
RRECOMMENDS:${KERNEL_PACKAGE_NAME}-base = ""

# U-Boot configuration
IMX_DEFAULT_BOOTLOADER:imx-nxp-bsp = "u-boot-boundary"
PREFERRED_PROVIDER_u-boot ??= "u-boot-boundary"
PREFERRED_PROVIDER_virtual/bootloader ??= "u-boot-boundary"
LOADADDR = ""
SPL_BINARY = "spl/u-boot-spl.bin"
UBOOT_DTB_NAME = "imx95-nitrogen-smarc.dtb"
UBOOT_MAKE_TARGET = ""
UBOOT_SUFFIX = "bin"
UBOOT_CONFIG ??= "sd"
UBOOT_CONFIG[sd]     = "imx95_nitrogen_smarc_defconfig,sdcard"

DDR_FIRMWARE_NAME = " \
    lpddr5_dmem_v202409.bin \
    lpddr5_dmem_qb_v202409.bin \
    lpddr5_imem_v202409.bin \
    lpddr5_imem_qb_v202409.bin \
"

IMXBOOT_TARGETS = "flash_all"
IMX_BOOT_SOC_TARGET = "iMX95"
IMX_BOOT_SEEK = "32"

M4_DEFAULT_IMAGE_MX95 = "imx95-19x19-evk_m7_TCM_power_mode_switch.bin"

IMAGE_BOOT_FILES:append = " \
	boot.scr-${MACHINE};boot.scr \
	upgrade.scr-${MACHINE};upgrade.scr \
	imx-boot-nitrogen95-sd.bin-flash_all;u-boot.imx95_nitrogen_smarc \
"

# wic support
WKS_FILE = "sdimage-bootpart.wks"
WKS_FILE_DEPENDS += "u-boot-script-boundary"

SERIAL_CONSOLES = "115200;ttyLP0"

ATF_PLATFORM = "imx95"
OEI_CONFIGS = "ddr tcm"
OEI_CORE   = "m33"
OEI_SOC    = "mx95"
OEI_BOARD  ?= "mx95lp5"
DDR_TYPE   ?= "lpddr5"

IMXBOOT_VARIANTS = "alt jailhouse netc"

# Multiple system manager configs by IMXBOOT_VARIANT
SYSTEM_MANAGER_CONFIG = "${@bb.utils.contains('IMXBOOT_VARIANT', 'alt',       'mx95alt', \
                            bb.utils.contains('IMXBOOT_VARIANT', 'jailhouse', 'mx95evkjailhouse', \
                            bb.utils.contains('IMXBOOT_VARIANT', 'netc',      'mx95netc', \
                                                                              'mx95evk', d), d), d)}"
```
