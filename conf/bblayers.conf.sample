## conf/bblayers.conf.sample
```bitbake
# POKY_BBLAYERS_CONF_VERSION is increased each time build/conf/bblayers.conf
# changes incompatibly
POKY_BBLAYERS_CONF_VERSION = "2"

BBPATH = "${TOPDIR}"
BBFILES ?= ""

BBLAYERS ?= " \
  ##OEROOT##/meta \
  ##OEROOT##/meta-poky \
  ##OEROOT##/meta-yocto-bsp \
  ##OEROOT##/../meta-arm/meta-arm \
  ##OEROOT##/../meta-arm/meta-arm-toolchain \
  ##OEROOT##/../meta-clang \
  ##OEROOT##/../meta-mediatek-bsp \
  ##OEROOT##/../meta-mediatek-tsn \
  ##OEROOT##/../meta-mediatek-bluedroid \
  ##OEROOT##/../meta-mediatek-demo \
  ##OEROOT##/../meta-nn \
  ##OEROOT##/../meta-stress-test \
  ##OEROOT##/../meta-security \
  ##OEROOT##/../meta-openembedded/meta-multimedia \
  ##OEROOT##/../meta-openembedded/meta-networking \
  ##OEROOT##/../meta-openembedded/meta-oe \
  ##OEROOT##/../meta-openembedded/meta-python \
  ##OEROOT##/../meta-openembedded/meta-perl \
  ##OEROOT##/../meta-rity/meta \
  ##OEROOT##/../meta-rity/meta-rity-bringup \
  ##OEROOT##/../meta-rity/meta-rity-bsp \
  ##OEROOT##/../meta-rity/meta-rity-demo \
  ##OEROOT##/../meta-tensorflow \
  ##OEROOT##/../meta-qt5 \
  ##OEROOT##/../meta-boundary \
  "
```

## conf/distro/boundary-b2qt-tungsten.conf
```bitbake
# Boundary Distro for Boot2Qt on Tungsten Platforms.

require conf/distro/rity-demo.conf

DISTRO = "boundary-b2qt-tungsten"
DISTRO_NAME = "Boundary Boot2Qt Tungsten"

SDK_MACHINE = "${@d.getVar('SDKMACHINE') or '${SDK_ARCH}'}"
SDK_NAME = "${DISTRO}-${SDK_MACHINE}-${IMAGE_BASENAME}"
TOOLCHAIN_OUTPUTNAME = "${SDK_NAME}-${MACHINE}"

# qt5-layer is not used in BSP
LAYERDEPENDS_rity-demo:remove = "qt5-layer"

# Need kms enabled in qtbase for eglfs to work
DISTRO_FEATURES:append = " kde"
```

## conf/distro/boundary-wayland.conf
```bitbake
# Boundary Distro for Wayland.

require conf/distro/fslc-wayland.conf

DISTRO = "boundary-wayland"
DISTRO_NAME = "Boundary Wayland"

IMX_DEFAULT_BSP = "nxp"

# Use fsl version of GStreamer for now as there's no gstreamer-imx for imx8m yet
MACHINE_GSTREAMER_1_0_PLUGIN_mx8 = "imx-gst1.0-plugin"
PREFERRED_VERSION_gstreamer1.0_mx8 ?= "1.16.2.imx"
PREFERRED_VERSION_gstreamer1.0-plugins-base_mx8 ?= "1.16.2.imx"
PREFERRED_VERSION_gstreamer1.0-plugins-good_mx8 ?= "1.16.3.imx"
PREFERRED_VERSION_gstreamer1.0-plugins-bad_mx8 ?= "1.16.3.imx"
```

## conf/distro/boundary-xwayland.conf
```bitbake
# Boundary Distro for XWayland.

require conf/distro/fslc-xwayland.conf

DISTRO = "boundary-xwayland"
DISTRO_NAME = "Boundary XWayland"

# Use fsl version of GStreamer for now as there's no gstreamer-imx for imx8m yet
MACHINE_GSTREAMER_1_0_PLUGIN:mx8mm-nxp-bsp  = "imx-gst1.0-plugin"
MACHINE_GSTREAMER_1_0_PLUGIN:mx8mq-nxp-bsp  = "imx-gst1.0-plugin"
```

## conf/distro/fsl-imx-base-ezurio.conf
```bitbake
include conf/distro/include/fsl-imx-base.inc
include conf/distro/include/fsl-imx-preferred-env.inc

DISTRO = "fsl-imx-base-ezurio"

PREFERRED_PROVIDER_virtual/kernel:imx-nxp-bsp = "linux-boundary"
PREFERRED_PROVIDER_virtual/bootloader:imx-nxp-bsp = "u-boot-boundary"

PREFERRED_RPROVIDER_networkmanager = "summit-networkmanager-lwb-if"
PREFERRED_RPROVIDER_networkmanager-nmcli = "summit-networkmanager-lwb-if"
PREFERRED_RPROVIDER_wireless-regdb-static = "wireless-regdb"
PREFERRED_RPROVIDER_wpa-supplicant = "summit-supplicant-lwb-if"
PREFERRED_RPROVIDER_wpa-supplicant-cli = "summit-supplicant-lwb-if"
PREFERRED_RPROVIDER_wpa-supplicant-passphrase = "summit-supplicant-lwb-if"

IMAGE_FSTYPES += " wic.gz wic.sparse"
IMAGE_CLASSES += " image_types_sparse"
```

## conf/layer.conf
```bitbake
# We have a conf and classes directory, append to BBPATH
BBPATH .= ":${LAYERDIR}"

# We have a recipes directory, add to BBFILES
BBFILES += "${LAYERDIR}/recipes-*/*/*.bb ${LAYERDIR}/recipes-*/*/*.bbappend"

BBFILE_COLLECTIONS += "boundary-layer"
BBFILE_PATTERN_boundary-layer := "^${LAYERDIR}/"
BBFILE_PRIORITY_boundary-layer = "8"
LAYERSERIES_COMPAT_boundary-layer = "warrior"

LICENSE_PATH += "${LAYERDIR}/licenses"

# The dynamic-layers directory hosts the extensions and layer specific
# modifications related to Boundary Devices products.
#
# The .bbappend and .bb files are included (only) if the respective layer
# collection is available.
BBFILES += "${@' '.join('${LAYERDIR}/dynamic-layers/%s/recipes*/*/*.bbappend' % layer \
               for layer in BBFILE_COLLECTIONS.split())}"
BBFILES += "${@' '.join('${LAYERDIR}/dynamic-layers/%s/recipes*/*/*.bb' % layer \
               for layer in BBFILE_COLLECTIONS.split())}"
```

## conf/machine/imx6-acl.conf
```bitbake
#@TYPE: Machine
#@NAME: Boundary Devices ACL
#@SOC: i.MX6 Q/DL
#@DESCRIPTION: Machine configuration for Boundary Devices ACL
#@MAINTAINER: Gary Bisson <gary.bisson@boundarydevices.com>
#
# By default, this machine will build for the standard Solo, 512M
# option. To build U-Boot for other CPU or memory combinations,
# you can set the UBOOT_MACHINE variable in your local.conf
# according to the following table:
#
# Processor           Memory    Configuration
# --------------      ------    --------------------
# i.MX6Quad              2GB    acl_q2g_defconfig
# i.MX6Solo            512MB    acl_s512m_defconfig
#

MACHINEOVERRIDES =. "mx6:mx6dl:mx6q:"

include conf/machine/include/imx-base.inc
include conf/machine/include/tune-cortexa9.inc

KERNEL_DEVICETREE = "imx6dl-acl.dtb \
                     imx6q-acl.dtb \
"
KERNEL_IMAGETYPE = "zImage"

PREFERRED_PROVIDER_u-boot = "u-boot-boundary"
PREFERRED_PROVIDER_virtual/kernel ?= "linux-boundary"

# Use SPI NOR U-Boot by default
IMAGE_BOOTLOADER ?= ""

IMAGE_FSTYPES = "sdcard.gz"

# Shorten boot volume ID (FAT limitation)
BOOTDD_VOLUME_ID = "Boot"

# Ensure boot scripts will be available at rootfs time
do_rootfs[depends] += "u-boot-script-boundary:do_deploy"

# Boot scripts to install
BOOT_SCRIPTS = "6x_bootscript-${MACHINE}:6x_bootscript"

UBOOT_MACHINE ?= "acl_512m_defconfig"

SERIAL_CONSOLE = "115200 ttymxc1"

MACHINE_EXTRA_RRECOMMENDS += " linux-firmware-gslx680 \
			libiio libiio-iiod libiio-tests \
			libmdi2300 libmdi2300-examples \
			printer-tools kernel-iio "
```

## conf/machine/nitrogen8ulp.conf
```bitbake
#@TYPE: Machine
#@NAME: Boundary Devices Nitrogen 8ULP based platforms
#@SOC: i.MX8ULP
#@DESCRIPTION: Machine configuration for Boundary Devices Nitrogen 8ULP
#@MAINTAINER: Chris Dimich <chris.dimich@boundarydevices.com>

MACHINEOVERRIDES =. "mx8:mx8ulp:"

IMX_DEFAULT_BSP ?= "nxp"

require conf/machine/include/imx-base.inc
require conf/machine/include/arm/armv8a/tune-cortexa35.inc

# Kernel configuration
PREFERRED_PROVIDER_virtual/kernel ??= "linux-boundary"
KERNEL_DEVICETREE = "freescale/imx8ulp-nitrogen-som.dtb \
	freescale/imx8ulp-nitrogen-som-m33.dtb \
"
KERNEL_IMAGETYPE = "Image"
RRECOMMENDS:${KERNEL_PACKAGE_NAME}-base = ""

# U-Boot configuration
IMX_DEFAULT_BOOTLOADER:imx-nxp-bsp = "u-boot-boundary"
PREFERRED_PROVIDER_u-boot ??= "u-boot-boundary"
PREFERRED_PROVIDER_virtual/bootloader ??= "u-boot-boundary"
PREFERRED_PROVIDER_imx-atf ??= "imx-atf-boundary"
SPL_BINARY = "spl/u-boot-spl.bin"
UBOOT_SUFFIX = "bin"

UBOOT_CONFIG ??= "2gr0"
UBOOT_CONFIG[2gr0]     = "imx8ulp_nitrogen_som_2gr0_defconfig,sdcard"

ATF_PLATFORM = "imx8ulp"

IMXBOOT_TARGETS = "flash_singleboot_m33"

IMX_BOOT_SOC_TARGET = "iMX8ULP"
IMX_BOOT_SEEK = "32"

MACHINE_FEATURES += "soc-reva1"
UPOWER_FIRMWARE_NAME = "upower_a1.bin"

IMAGE_BOOT_FILES:append = " \
	boot.scr-${MACHINE};boot.scr \
	upgrade.scr-${MACHINE};upgrade.scr \
	imx-boot-nitrogen8ulp-2gr0.bin-flash_singleboot_m33;u-boot.imx8ulp_nitrogen_som_2gr0 \
"

# wic support
WKS_FILE = "sdimage-bootpart.wks"
WKS_FILE_DEPENDS += "u-boot-script-boundary"

SERIAL_CONSOLES = "115200;ttyLP3"
```

## conf/machine/tungsten-510-smarc.conf
```bitbake
require conf/machine/include/mt8370.inc
require conf/machine/include/mt7921.inc

# Kernel
KERNEL_DEVICETREE = "mediatek/mt8370-tungsten-smarc.dtb"

# U-Boot
UBOOT_MACHINE = "mt8370_tungsten_smarc_defconfig"
PREFERRED_PROVIDER_u-boot = "u-boot-boundary"
PREFERRED_PROVIDER_virtual/bootloader = "u-boot-boundary"

# libdram
LIBDRAM_BOARD_NAME = "genio-700-evk"

# OP-TEE
OPTEE_DRAM_SIZE = "0x100000000"

# LK
LK_BOARD_NAME = "${LIBDRAM_BOARD_NAME}"

MACHINE_FEATURES:append = " alsa bluetooth pci usbgadget usbhost wifi tsn"

MACHINEOVERRIDES =. "mt8370-evk:genio-510-evk:"

SERIAL_CONSOLES = "115200;ttyS0"
```

## conf/machine/tungsten-700-smarc.conf
```bitbake
require conf/machine/include/mt8188.inc
require conf/machine/include/mt7921.inc

# Kernel
KERNEL_DEVICETREE = "mediatek/mt8390-tungsten-smarc.dtb"

# U-Boot
UBOOT_MACHINE = "mt8390_tungsten_smarc_defconfig"
PREFERRED_PROVIDER_u-boot = "u-boot-boundary"
PREFERRED_PROVIDER_virtual/bootloader = "u-boot-boundary"

# Unset dtbo as preferred dtb provider, so that dtbos are pulled from boundary linux-mtk kernel
PREFERRED_PROVIDER_virtual/dtb:remove = "dtbo"

# libdram
LIBDRAM_BOARD_NAME = "genio-700-evk"

# OP-TEE
OPTEE_DRAM_SIZE = "0x200000000"

# LK
LK_BOARD_NAME = "${LIBDRAM_BOARD_NAME}"

MACHINE_FEATURES:append = " alsa bluetooth pci usbgadget usbhost wifi tsn"

MACHINEOVERRIDES =. "mt8188-evk:mt8390-evk:genio-700-evk:"

SERIAL_CONSOLES = "115200;ttyS0"
```

## recipes-bsp/u-boot/files/boot.script.its
```
/dts-v1/;

/ {
        description = "Boot script to be embedded";
        #address-cells = <1>;

        images {
                default = "bootscr-boot.script";
                bootscr-boot.script {
                        description = "U-boot script";
                        data = /incbin/("boot.script");
                        type = "script";
                        arch = "arm64";
                        compression = "none";
                        hash-1 {
                                algo = "sha256";
                        };
                        signature-1 {
                                algo = "sha256,rsa2048";
                                key-name-hint = "u-boot-img";
                        };
                };
        };

        configurations {
                default = "conf-bootscr-boot.script";
                conf-bootscr-boot.script {
                        description = "u-boot script";
                        bootscr = "bootscr-boot.script";

                        hash-1 {
                                algo = "sha256";
                        };
                        signature-1 {
                                algo = "sha256,rsa2048";
                                key-name-hint = "u-boot";
                                padding = "pkcs-1.5";
                                sign-images = "bootscr";
                        };
                };
        };
};
```
